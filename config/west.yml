## config/west.yml
```yaml
manifest:
  remotes:
    - name: zmkfirmware
      url-base: https://github.com/Xoffio/
  projects:
    - name: zmk
      remote: zmkfirmware
      revision: rgb-effect-imp
      import: app/west.yml
  self:
    path: config
```
